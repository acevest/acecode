## hardware/esp8266_wifi/main/Kconfig.projbuild
```kconfig
menu "ESP8266 WiFi Configuration"

config ESP_WIFI_SSID
    string "WiFi SSID"
    default ""
    help
	SSID (network name) for the example to connect to.

config ESP_WIFI_PASSWORD
    string "WiFi Password"
    default ""
    help
	WiFi password (WPA or WPA2) for the example to use.
		
endmenu
```

## rtos/components/kernel/Kconfig.projbuild
```kconfig
menu "Kernel config"
config KERNEL_NAME
	string "Kernel name"
	default "rtos"
	help
		what's the kenel name
endmenu
```

## rtos/make/Kconfig.projbuild
```kconfig
menu "Example Configuration"

config EXAMPLE_CONF_VAL
	int "example configuration value"
	range 0 34
	default 3
	help
		example configuration value

endmenu
```
